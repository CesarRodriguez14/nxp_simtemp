## kernel/Kconfig
```kconfig
config NXP_SIMTEMP_DRIVER
	tristate "NXP-simtemp Driver"
	help
		NXP-simtemp Driver
```

## meta-nxpsimtemp/conf/layer.conf
```bitbake
# We have a conf and classes directory, add to BBPATH
BBPATH .= ":${LAYERDIR}"

# We have recipes-* directories, add to BBFILES
BBFILES += "${LAYERDIR}/recipes-*/*/*.bb \
            ${LAYERDIR}/recipes-*/*/*.bbappend"

BBFILE_COLLECTIONS += "meta-nxpsimtemp"
BBFILE_PATTERN_meta-nxpsimtemp = "^${LAYERDIR}/"
BBFILE_PRIORITY_meta-nxpsimtemp = "6"

LAYERDEPENDS_meta-nxpsimtemp = "core"
LAYERSERIES_COMPAT_meta-nxpsimtemp = "dunfell"
```
